#include "Ssd1306.hpp"
#include "esp_log.h"
#include <cstring>

static const char* TAG = "SSD1306";

// 6x8 font covering ASCII 32-127 (space through ~)
// Each character is 6 columns wide, 8 rows tall (1 byte per column)
static const uint8_t kFont6x8[][6] = {
    {0x00,0x00,0x00,0x00,0x00,0x00}, // 32 ' '
    {0x00,0x00,0x5F,0x00,0x00,0x00}, // 33 '!'
    {0x00,0x07,0x00,0x07,0x00,0x00}, // 34 '"'
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    {0x08,0x08,0x2A,0x1C,0x08,0x00}, // 126 '~'
};

static constexpr size_t kFontFirstChar = 32;
static constexpr size_t kFontCharWidth = 6;

namespace Arcana {
namespace Lcd {

Ssd1306::Ssd1306(gpio_num_t sclPin, gpio_num_t sdaPin, uint8_t addr)
    : mSclPin(sclPin), mSdaPin(sdaPin), mAddr(addr) {}

Ssd1306::~Ssd1306() {
    if (mDevHandle) {
        i2c_master_bus_rm_device(mDevHandle);
    }
    if (mBusHandle) {
        i2c_del_master_bus(mBusHandle);
    }
}

esp_err_t Ssd1306::Init() {
    // Configure I2C master bus
    i2c_master_bus_config_t bus_config = {};
    bus_config.clk_source = I2C_CLK_SRC_DEFAULT;
    bus_config.i2c_port = I2C_NUM_0;
    bus_config.scl_io_num = mSclPin;
    bus_config.sda_io_num = mSdaPin;
    bus_config.glitch_ignore_cnt = 7;
    bus_config.flags.enable_internal_pullup = true;

    esp_err_t err = i2c_new_master_bus(&bus_config, &mBusHandle);
    if (err != ESP_OK) {
        ESP_LOGE(TAG, "I2C bus init failed: %s", esp_err_to_name(err));
        return err;
    }

    // Add SSD1306 device
    i2c_device_config_t dev_config = {};
    dev_config.dev_addr_length = I2C_ADDR_BIT_LEN_7;
    dev_config.device_address = mAddr;
    dev_config.scl_speed_hz = 400000;

    err = i2c_master_bus_add_device(mBusHandle, &dev_config, &mDevHandle);
    if (err != ESP_OK) {
        ESP_LOGE(TAG, "I2C add device failed: %s", esp_err_to_name(err));
        return err;
    }

    // SSD1306 initialization sequence (128x64)
    static const uint8_t initCmds[] = {
        0xAE,       // Display OFF
        0xD5, 0x80, // Set display clock divide ratio
        0xA8, 0x3F, // Set multiplex ratio (64-1)
        0xD3, 0x00, // Set display offset = 0
        0x40,       // Set start line = 0
        0x8D, 0x14, // Enable charge pump
        0x20, 0x00, // Set horizontal addressing mode
        0xA1,       // Set segment re-map (col 127 -> SEG0)
        0xC8,       // Set COM output scan direction (remapped)
        0xDA, 0x12, // Set COM pins hardware config
        0x81, 0xCF, // Set contrast
        0xD9, 0xF1, // Set pre-charge period
        0xDB, 0x40, // Set VCOMH deselect level
        0xA4,       // Entire display ON (resume to RAM)
        0xA6,       // Normal display (not inverted)
        0xAF,       // Display ON
    };

    err = SendCommands(initCmds, sizeof(initCmds));
    if (err != ESP_OK) {
        ESP_LOGE(TAG, "Init commands failed: %s", esp_err_to_name(err));
        return err;
    }

    Clear();
    Display();

    ESP_LOGI(TAG, "Initialized (128x64, I2C addr=0x%02X)", mAddr);
    return ESP_OK;
}

void Ssd1306::Clear() {
    memset(mBuffer, 0, kBufSize);
    mCursorCol = 0;
    mCursorPage = 0;
}

void Ssd1306::SetCursor(uint8_t col, uint8_t page) {
    mCursorCol = col;
    mCursorPage = page;
}

void Ssd1306::DrawChar(char c) {
    if (c < 32 || c > 126) c = ' ';
    size_t idx = c - kFontFirstChar;

    for (uint8_t i = 0; i < kFontCharWidth; i++) {
        if (mCursorCol < kWidth) {
            mBuffer[mCursorPage * kWidth + mCursorCol] = kFont6x8[idx][i];
            mCursorCol++;
        }
    }
}

void Ssd1306::DrawString(const char* str) {
    while (*str) {
        DrawChar(*str++);
    }
}

void Ssd1306::DrawStringAt(uint8_t col, uint8_t page, const char* str) {
    SetCursor(col, page);
    DrawString(str);
}

void Ssd1306::Display() {
    // Set column address range 0-127
    uint8_t colCmd[] = {0x00, 0x21, 0x00, 0x7F};
    i2c_master_transmit(mDevHandle, colCmd, sizeof(colCmd), 100);

    // Set page address range 0-7
    uint8_t pageCmd[] = {0x00, 0x22, 0x00, 0x07};
    i2c_master_transmit(mDevHandle, pageCmd, sizeof(pageCmd), 100);

    // Send framebuffer: 0x40 prefix (data mode) + 1024 bytes
    // Send in chunks to avoid large stack allocation
    static constexpr size_t kChunkSize = 128;
    uint8_t chunk[1 + kChunkSize]; // 0x40 + data
    chunk[0] = 0x40; // Co=0, D/C#=1 (data)

    for (size_t offset = 0; offset < kBufSize; offset += kChunkSize) {
        memcpy(&chunk[1], &mBuffer[offset], kChunkSize);
        i2c_master_transmit(mDevHandle, chunk, 1 + kChunkSize, 100);
    }
}

esp_err_t Ssd1306::SendCommand(uint8_t cmd) {
    uint8_t buf[2] = {0x00, cmd}; // Co=0, D/C#=0 (command)
    return i2c_master_transmit(mDevHandle, buf, 2, 100);
}

esp_err_t Ssd1306::SendCommands(const uint8_t* cmds, size_t len) {
    for (size_t i = 0; i < len; i++) {
        esp_err_t err = SendCommand(cmds[i]);
        if (err != ESP_OK) return err;
    }
    return ESP_OK;
}

} // namespace Lcd
} // namespace Arcana
